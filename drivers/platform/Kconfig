## drivers/platform/Kconfig
```kconfig
if X86
source "drivers/platform/x86/Kconfig"
endif
if MIPS
source "drivers/platform/mips/Kconfig"
endif
source "drivers/platform/goldfish/Kconfig"

source "drivers/platform/chrome/Kconfig"

if ARCH_MSM
source "drivers/platform/msm/Kconfig"
source "drivers/platform/xiaomi/Kconfig"
endif
```
